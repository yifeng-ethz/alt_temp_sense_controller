# MU3E_ALT_TEMP_SENSE_CTRL register map
Vendor: Mu3e; Series: MU3E_FPGA_IP; File version: 1.1
CMSIS-SVD description of the altera_temp_sense_ctrl wrapper CSR. BaseAddress is 0 because this file describes the relative CSR aperture of the IP; system integration supplies the live slave base address.
Registers are 32-bit, read-write, reset 0x0 unless marked. A register's access mark holds for its fields unless they carry their own. Offsets are from the block's base; lines under a group give offsets from that group; [hi:lo] are bit positions; {n}, {i} and the like mark numbered series; 'fields as' and 'values as' point back to an identical list; <NAME> marks a mode.

## Memory map
0x00000000 ALTERA_TEMP_SENSE_CTRL_CSR size 0x4 — Single-word control/status aperture for the Arria-V temperature-sense wrapper.

## ALTERA_TEMP_SENSE_CTRL_CSR — Single-word control/status aperture for the Arria-V temperature-sense wrapper.
Base 0x00000000
0x00 CSR — Shared control/status word for the Arria-V on-die temperature sensor wrapper. Reads return the signed 8-bit temperature sample in bits [7:0]. Writes use bit 0 to enable or disable periodic sampling; other bits are ignored.
  [7:0] temperature_signed ro — Readback-only signed 8-bit Arria-V temperature code.
